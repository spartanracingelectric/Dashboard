VERSION ""

NS_ :

BS_:

BU_: Dashboard Simulator

BO_ 1280 TPS0: 8 Simulator
 SG_ TPS0_Percent : 0|8@1+ (0.392157,0) [0|100] "%" Dashboard
 SG_ TPS0_Voltage : 16|16@1+ (0.001,0) [0|65.535] "V" Dashboard

BO_ 1281 TPS1: 8 Simulator
 SG_ TPS1_Percent : 0|8@1+ (0.392157,0) [0|100] "%" Dashboard
 SG_ TPS1_Voltage : 16|16@1+ (0.001,0) [0|65.535] "V" Dashboard

BO_ 1287 LV_EffScore: 8 Simulator
 SG_ LV_Voltage : 0|16@1+ (0.001,0) [0|65.535] "V" Dashboard
 SG_ Eff_Score : 48|16@1- (0.0001,0) [-2|2] "" Dashboard

BO_ 1568 HV: 8 Simulator
 SG_ HV_Current : 0|32@1+ (0.001,0) [0|4294967.295] "A" Dashboard
 SG_ HV_Voltage : 32|32@1+ (0.001,0) [0|4294967.295] "V" Dashboard

BO_ 1571 BAT_TEMP: 8 Simulator
 SG_ HV_Temp : 48|16@1+ (0.1,0) [0|6553.5] "degC" Dashboard

BO_ 0 SOC: 8 Simulator
 SG_ SOC : 48|16@1+ (0.1,0) [0|6553.5] "%" Dashboard

BO_ 1 BMS_FAULT: 8 Simulator
 SG_ BMS_Fault : 8|8@1+ (1,0) [0|255] "" Dashboard

BO_ 2 BMS_WARN: 8 Simulator
 SG_ BMS_Warn : 8|8@1+ (1,0) [0|255] "" Dashboard

BO_ 3 BMS_STAT: 8 Simulator
 SG_ BMS_Stat : 48|8@1+ (1,0) [0|255] "" Dashboard

BO_ 165 RPM: 8 Simulator
 SG_ RPM : 8|16@1+ (1,0) [0|65535] "rpm" Dashboard

BO_ 1697 ENERGY_USED: 8 Simulator
 SG_ Energy_Used : 0|32@1+ (0.001,0) [0|4294967.295] "kWh" Dashboard

CM_ BO_ 1280 "Throttle Position Sensor 0 - percent and raw voltage";
CM_ BO_ 1281 "Throttle Position Sensor 1 - percent and raw voltage";
CM_ BO_ 1287 "LV battery voltage (bytes 0-1) and efficiency score (bytes 6-7)";
CM_ BO_ 1568 "HV current (bytes 0-3) and HV voltage (bytes 4-7)";
CM_ BO_ 1571 "Battery temperature pack (bytes 6-7)";
CM_ BO_ 0 "State of charge (bytes 6-7)";
CM_ BO_ 1 "BMS fault code (byte 1)";
CM_ BO_ 2 "BMS warning code (byte 1)";
CM_ BO_ 3 "BMS status (byte 6)";
CM_ BO_ 165 "Motor RPM (bytes 1-2, little-endian u16(d,2,1))";
CM_ BO_ 1697 "Cumulative energy used in Wh, displayed as kWh";
